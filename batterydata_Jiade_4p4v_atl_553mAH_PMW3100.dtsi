/* Copyright (c) 2017-2018, The Linux Foundation. All rights reserved.
 *
 * This program is free software; you can redistribute it and/or modify
 * it under the terms of the GNU General Public License version 2 and
 * only version 2 as published by the Free Software Foundation.
 *
 * This program is distributed in the hope that it will be useful,
 * but WITHOUT ANY WARRANTY; without even the implied warranty of
 * MERCHANTABILITY or FITNESS FOR A PARTICULAR PURPOSE.  See the
 * GNU General Public License for more details.
 */


qcom,3961614_lc_jiade_553mah_pmw3100_averaged_masterslave_jun14th2019 {
	qcom, = <24>;
	/* #3961614_LC_Jiade_553mAH_PMW3100_averaged_MasterSlave_Jun14th2019*/
	qcom,max-voltage-uv = <4400000>;
	qcom,fg-cc-cv-threshold-mv = <4390>;
	qcom,nom-batt-capacity-mah = <553>;
	qcom,batt-id-kohm = <125>;
	qcom,battery-beta = <4250>;
	qcom,battery-type = "jiade_553mah_pmw3100";
	qcom,checksum = <0x2811>;
	qcom,gui-version = "PM660GUI - 0.0.0.45";
	qcom,fastchg-current-ma = <300>;
	qcom,fg-profile-data = [
		 08 22 7C 0D
		 36 12 8F 04
		 03 1D D5 FA
		 CC 05 DC 02
		 8D 18 D6 22
		 BE 45 78 52
		 95 00 00 00
		 13 00 00 00
		 00 00 71 B5
		 CA CD 13 C2
		 48 00 08 00
		 A3 E3 5F EC
		 23 DD 44 ED
		 4E F2 9A 03
		 28 05 3F 4B
		 0D 06 09 20
		 27 00 14 00
		 B3 1F 73 05
		 D8 0A D3 05
		 C0 1C 2B 03
		 BA 15 A5 12
		 9F 18 81 23
		 71 44 83 5A
		 63 00 00 00
		 0F 00 00 00
		 00 00 05 CD
		 E5 C2 00 9C
		 40 00 00 00
		 B9 F2 5F EC
		 05 00 1D ED
		 D9 00 0C 02
		 59 F5 84 1A
		 99 33 CC FF
		 07 10 00 00
		 4F 02 33 47
		 40 00 40 00
		 7D 03 0A FA
		 FF 00 00 00
		 00 00 00 00
		 00 00 00 00
		 00 00 00 00
		 00 00 00 00
		 00 00 00 00
		 00 00 00 00
		 00 00 00 00
		 00 00 00 00
		 00 00 00 00
		 00 00 00 00
		 00 00 00 00
		 00 00 00 00
		 00 00 00 00
		 00 00 00 00
		 00 00 00 00
		 00 00 00 00
		 00 00 00 00
		 00 00 00 00
	];
};
	

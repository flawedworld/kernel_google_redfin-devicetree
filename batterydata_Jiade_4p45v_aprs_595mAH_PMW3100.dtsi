
qcom,4061979_lc_jiade_595mah_pm660_averaged_masterslave_jul25th2019 {
	qcom, = <24>;
	/* #4061979_LC_Jiade_595mAH_PM660_averaged_MasterSlave_Jul25th2019*/
	qcom,max-voltage-uv = <4450000>;
	qcom,fg-cc-cv-threshold-mv = <4440>;
	qcom,nom-batt-capacity-mah = <595>;
	qcom,batt-id-kohm = <100>;
	qcom,battery-beta = <4250>;
	qcom,battery-type = "jiade_aprs_595mah_pm660";
	qcom,checksum = <0x0B9F>;
	qcom,gui-version = "PM660GUI - 0.0.0.45";
	qcom,fastchg-current-ma = <300>;
	qcom,fg-profile-data = [
		 75 22 2B 0D
		 83 12 F2 0D
		 EF 1C 80 01
		 A7 05 09 03
		 BD 18 62 22
		 A8 3C 3C 4B
		 94 00 00 00
		 16 00 00 00
		 00 00 92 BC
		 E8 C4 2E C2
		 45 00 08 00
		 1A E3 51 ED
		 93 FD 0F F2
		 69 07 2F 03
		 BC 0D 88 3B
		 16 06 09 20
		 27 00 14 00
		 DC 1F 2D 05
		 1F 0B 82 05
		 CA 1C 04 03
		 DD 15 81 12
		 9C 18 E7 23
		 C9 4D 7C 5B
		 65 00 00 00
		 0D 00 00 00
		 00 00 26 CD
		 F2 C2 CD BD
		 40 00 00 00
		 D4 EB 51 ED
		 1A 07 F4 E3
		 CA 07 0F 01
		 A3 0A 0D 23
		 CF 33 CC FF
		 07 10 00 00
		 64 02 33 47
		 40 00 40 00
		 92 03 0A FA
		 FF 00 00 00
		 00 00 00 00
		 00 00 00 00
		 00 00 00 00
		 00 00 00 00
		 00 00 00 00
		 00 00 00 00
		 00 00 00 00
		 00 00 00 00
		 00 00 00 00
		 00 00 00 00
		 00 00 00 00
		 00 00 00 00
		 00 00 00 00
		 00 00 00 00
		 00 00 00 00
		 00 00 00 00
		 00 00 00 00
		 00 00 00 00
	];
};
